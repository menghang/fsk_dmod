## sdkconfig.defaults
```kconfig
CONFIG_ESPTOOLPY_FLASHSIZE_8MB=y
CONFIG_ESPTOOLPY_FLASHMODE_QIO=y
CONFIG_ESPTOOLPY_FLASHFREQ_80M=y
# CONFIG_ESPTOOLPY_FLASHSIZE_DETECT is not set

CONFIG_ESP32S3_DEFAULT_CPU_FREQ_240=y

CONFIG_ESP32S3_SPIRAM_SUPPORT=y
CONFIG_SPIRAM_MODE_OCT=y
CONFIG_SPIRAM_SPEED_80M=y

CONFIG_COMPILER_OPTIMIZATION_PERF=y
CONFIG_UART_ISR_IN_IRAM=y
CONFIG_ESP_SYSTEM_PANIC_PRINT_HALT=y

CONFIG_ESP_CONSOLE_UART_CUSTOM=y
CONFIG_ESP_CONSOLE_UART_BAUDRATE=2000000
CONFIG_ESPTOOLPY_MONITOR_BAUD_OTHER=y
CONFIG_ESPTOOLPY_MONITOR_BAUD_OTHER_VAL=2000000

CONFIG_LOG_DEFAULT_LEVEL_INFO=y

CONFIG_ESP_MAIN_TASK_STACK_SIZE=10240
```
